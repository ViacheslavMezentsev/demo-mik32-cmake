# MIK32 register map
Vendor: Mikron JSC; Series: MIK32; File version: 1.0
MIK32_V2 reference description for 32-bit MCU with Syntacore SCR1 RV32IMC RISC-V CPU
Registers are 32-bit, read-write, reset 0x0 unless marked. A register's access mark holds for its fields unless they carry their own. Offsets are from the block's base; lines under a group give offsets from that group; [hi:lo] are bit positions; {n}, {i} and the like mark numbered series; 'fields as' and 'values as' point back to an identical list; <NAME> marks a mode.

## Memory map
0x00040000 DMA size 0x44 — Прямой доступ к памяти
0x00050000 PM size 0x40 — Блок управления питанием и тактированием
0x00050400 EPIC size 0x24 — Программируемый контроллер прерываний
0x00050800 TIMER32_0 size 0x20 — Регистры модуля TIMER32_0
0x00050C00 PAD_CONFIG size 0x24 — Модуль управления функцией ввода/вывода
0x00051000 WDT_BUS size 0xC — Сторожевой таймер шины
0x00051400 OTP size 0x20 — Контроллер блока однократно-программируемой памяти
0x00051800 PVD_VCC size 0xC — Управление монитором напряжения VCC
0x00060000 WakeUp size 0x20 — Блок WakeUp - управление питанием системным доменом, управление источниками тактовых сигналов
0x00060400 RTC size 0x60 — Часы реального времени
0x00060800 BOOT_MANAGER size 0x8 — Блок управления режимом загрузки
0x00070000 SPIFI_CONFIG size 0x20 — Контроллер SPIFI
0x00070400 EEPROM_REGS size 0x24 — Контроллер EEPROM (8Кб)
0x00080000 CRYPTO size 0x10 — Криптоблок
0x00080400 CRC size 0xC — Блок вычисления контрольных сумм
0x00081000 WDT size 0xA0 — Сторожевой таймер
0x00081400 USART_0 size 0x30 — Универсальный синхронный/асинхронный приёмопередатчик (УСАПП)
0x00081800 USART_1 size 0x30 — Универсальный синхронный/асинхронный приёмопередатчик (УСАПП)
0x00081C00 TIMER16_0 size 0x20 — Регистры модуля TIMER16_0
0x00082000 TIMER16_1 size 0x20 — Регистры модуля TIMER16_1
0x00082400 TIMER16_2 size 0x20 — Регистры модуля TIMER16_2
0x00082800 TIMER32_1 size 0xBC — Регистры модуля TIMER32_1
0x00082C00 TIMER32_2 size 0xBC — Регистры модуля TIMER32_2
0x00083000 SPI_0 size 0x30 — Модуль обеспечивает взаимодействие с различными периферийными устройствами
0x00083400 SPI_1 size 0x30 — Модуль обеспечивает взаимодействие с различными периферийными устройствами
0x00083800 I2C_0 size 0x28 — Модуль обеспечивает интерфейс для связи контроллера и последовательной шины I2C
0x00083C00 I2C_1 size 0x28 — Модуль обеспечивает интерфейс для связи контроллера и последовательной шины I2C
0x00084000 GPIO_0 size 0x18 — Модуль ввода/вывода
0x00084400 GPIO_1 size 0x18 — Модуль ввода/вывода
0x00084800 GPIO_2 size 0x18 — Модуль ввода/вывода
0x00084C00 GPIO_IRQ size 0x30 — Модуль формирования прерываний
0x00085000 DAC0 size 0x8 — Управление ЦАП
0x00085008 DAC1 size 0x8 — Управление ЦАП
0x00085010 PVD_AVCC size 0xC — Управление монитором напряжения AVCC
0x0008501C TSENS size 0x1C — Управление температурным сенсором
0x00085038 REFV_CONFIG size 0x4 — Управление калибруемыми источниками напряжения и тока
0x0008503C ADC size 0x14 — Управление АЦП
0x00490000 SCR1_TIMER size 0x18 — Регистры 64-разрядного таймера ядра SCR1

## Licence text in the file
MIT License . Copyright (C) 2024 Лаборатория системных разработок, Mikron JSC . Permission is hereby granted, free of charge, to any person obtaining a copy of this software and associated documentation files (the «Software»), to deal in the Software without restriction, including without limitation the rights to use, copy, modify, merge, publish, distribute, sublicense, and/or sell copies of the Software, and to permit persons to whom the Software is furnished to do so, subject to the following conditions: . The above copyright notice and this permission notice shall be included in all copies or substantial portions of the Software. . THE SOFTWARE IS PROVIDED «AS IS», WITHOUT WARRANTY OF ANY KIND, EXPRESS OR. IMPLIED, INCLUDING BUT NOT LIMITED TO THE WARRANTIES OF MERCHANTABILITY, FITNESS FOR A PARTICULAR PURPOSE AND NONINFRINGEMENT. IN NO EVENT SHALL THE. AUTHORS OR COPYRIGHT HOLDERS BE LIABLE FOR ANY CLAIM, DAMAGES OR OTHER. LIABILITY, WHETHER IN AN ACTION OF CONTRACT, TORT OR OTHERWISE, ARISING FROM, OUT OF OR IN CONNECTION WITH THE SOFTWARE OR THE USE OR OTHER DEALINGS IN THE. SOFTWARE.
